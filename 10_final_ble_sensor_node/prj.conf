## CMakeLists.txt
```
cmake_minimum_required(VERSION 3.20.0)
find_package(Zephyr REQUIRED HINTS $ENV{ZEPHYR_BASE})
project(ble_sensor_node)

set(CMAKE_CXX_STANDARD 17)

target_sources(app PRIVATE
    src/main.cpp
    src/led.cpp
    src/sensor.cpp
    src/ble_manager.cpp
    src/sensor_thread.cpp
)

target_include_directories(app PRIVATE src)
```

## prj.conf
```kconfig
CONFIG_CPP=y
CONFIG_STD_CPP17=y
CONFIG_GPIO=y

# BLE
CONFIG_BT=y
CONFIG_BT_PERIPHERAL=y
CONFIG_BT_DEVICE_NAME="NRF5340-SENSOR"
CONFIG_BT_DEVICE_APPEARANCE=768

# Logging
CONFIG_LOG=y
CONFIG_UART_CONSOLE=y

# Heap for std::function
CONFIG_HEAP_MEM_POOL_SIZE=4096
```

## src/main.cpp
```c
/*
 * Exercise 10 — Final Project: BLE Sensor Node
 *
 * Integration of all concepts from Exercises 01-09.
 * Your task: implement the TODOs in each component file and
 * wire them together here.
 *
 * Build: west build -b nrf5340dk/nrf5340/cpuapp
 */

#include <zephyr/kernel.h>
#include <zephyr/drivers/gpio.h>
#include <zephyr/sys/printk.h>

#include "led.hpp"
#include "sensor.hpp"
#include "ble_manager.hpp"
#include "sensor_thread.hpp"

namespace sensor_node {

/* Device tree specs */
static const gpio_dt_spec kLed0 = GPIO_DT_SPEC_GET(DT_ALIAS(led0), gpios);
static const gpio_dt_spec kLed1 = GPIO_DT_SPEC_GET(DT_ALIAS(led1), gpios);
static const gpio_dt_spec kLed2 = GPIO_DT_SPEC_GET(DT_ALIAS(led2), gpios);
static const gpio_dt_spec kLed3 = GPIO_DT_SPEC_GET(DT_ALIAS(led3), gpios);
static const gpio_dt_spec kBtn0 = GPIO_DT_SPEC_GET(DT_ALIAS(sw0),  gpios);

} // namespace sensor_node

int main(void)
{
    using namespace sensor_node;

    /* --- Hardware objects --- */
    Led led_adv{kLed0};       /* advertising indicator */
    Led led_conn{kLed1};      /* connected indicator   */
    Led led_err{kLed2};       /* sensor error          */
    Led led_beat{kLed3};      /* heartbeat             */

    gpio_pin_configure_dt(&kBtn0, GPIO_INPUT | GPIO_PULL_UP);

    /* --- Sensor and thread --- */
    SimTempSensor sensor;
    SensorThread sensor_thread{sensor, led_err, led_beat};

    /* --- BLE manager --- */
    BleManager &ble = BleManager::instance();
    ble.init();

    /* Wire BLE callbacks using lambdas */
    ble.set_on_connect([&]() {
        led_adv.off();
        led_conn.on();
        printk("Connected — LED2 on\n");
    });

    ble.set_on_disconnect([&]() {
        led_conn.off();
        printk("Disconnected — restarting advertising\n");
        ble.start_advertising();
    });

    /* Forward sensor readings to BLE notify */
    sensor_thread.set_sample_callback([&](float temp) {
        if (ble.state() == BleState::Connected) {
            ble.notify_temperature(temp);
        }
    });

    /* Start everything */
    ble.start_advertising();
    sensor_thread.start();

    printk("=== BLE Sensor Node running ===\n");

    /* Main loop: advertising blink + button handling */
    bool last_btn = false;
    while (true) {
        /* Blink advertising LED when not connected */
        if (ble.state() == BleState::Advertising) {
            led_adv.toggle();
        }

        /* Button 1: force disconnect or restart advertising */
        bool pressed = (gpio_pin_get_dt(&kBtn0) == 0);
        if (pressed && !last_btn) {
            if (ble.state() == BleState::Connected) {
                printk("Button: force disconnect\n");
                ble.disconnect();
            } else if (ble.state() == BleState::Idle) {
                printk("Button: restart advertising\n");
                ble.start_advertising();
            }
        }
        last_btn = pressed;

        k_msleep(500);
    }

    return 0;
}
```

## src/ble_manager.cpp
```c
#include "ble_manager.hpp"
#include <zephyr/sys/printk.h>

namespace sensor_node {

/* Advertising data — modify UUID bytes to your own 128-bit UUID */
static const struct bt_data kAdvData[] = {
    BT_DATA_BYTES(BT_DATA_FLAGS, BT_LE_AD_GENERAL | BT_LE_AD_NO_BREDR),
    BT_DATA_BYTES(BT_DATA_UUID128_ALL,
        0x12, 0x34, 0x56, 0x78, 0x9a, 0xbc, 0xde, 0xf0,
        0x11, 0x22, 0x33, 0x44, 0x55, 0x66, 0x77, 0x88),
};

static struct bt_conn_cb kConnCallbacks = {
    .connected    = BleManager::connected_cb,
    .disconnected = BleManager::disconnected_cb,
};

BleManager &BleManager::instance()
{
    static BleManager inst;
    return inst;
}

void BleManager::init()
{
    bt_conn_cb_register(&kConnCallbacks);

    int err = bt_enable(nullptr);
    if (err) {
        printk("BLE init failed: %d\n", err);
        return;
    }
    printk("BLE enabled\n");
    state_ = BleState::Idle;
}

void BleManager::start_advertising()
{
    if (state_ != BleState::Idle) {
        return;
    }
    int err = bt_le_adv_start(BT_LE_ADV_CONN_NAME,
                               kAdvData, ARRAY_SIZE(kAdvData),
                               nullptr, 0);
    if (err) {
        printk("Advertising failed: %d\n", err);
        return;
    }
    state_ = BleState::Advertising;
    printk("BLE advertising started\n");
}

void BleManager::disconnect()
{
    if (conn_) {
        bt_conn_disconnect(conn_, BT_HCI_ERR_REMOTE_USER_TERM_CONN);
    }
}

void BleManager::notify_temperature(float temp)
{
    /* TODO: call bt_gatt_notify with the temperature characteristic attribute */
    (void)temp;
}

void BleManager::handle_connected(struct bt_conn *conn, uint8_t err)
{
    if (err) {
        printk("BLE connect failed: %u\n", err);
        return;
    }
    conn_  = bt_conn_ref(conn);
    state_ = BleState::Connected;
    printk("BLE connected\n");
    if (on_connect_) on_connect_();
}

void BleManager::handle_disconnected(struct bt_conn *conn, uint8_t reason)
{
    printk("BLE disconnected (reason %u)\n", reason);
    if (conn_) {
        bt_conn_unref(conn_);
        conn_ = nullptr;
    }
    state_ = BleState::Idle;
    if (on_disconnect_) on_disconnect_();
}

void BleManager::connected_cb(struct bt_conn *conn, uint8_t err)
{
    instance().handle_connected(conn, err);
}

void BleManager::disconnected_cb(struct bt_conn *conn, uint8_t reason)
{
    instance().handle_disconnected(conn, reason);
}

} // namespace sensor_node
```

## src/ble_manager.hpp
```c
#pragma once
#include <functional>
#include <zephyr/bluetooth/bluetooth.h>
#include <zephyr/bluetooth/conn.h>

namespace sensor_node {

enum class BleState { Idle, Advertising, Connected };

class BleManager {
public:
    using ConnectCallback    = std::function<void()>;
    using DisconnectCallback = std::function<void()>;

    static BleManager &instance();

    void init();
    void start_advertising();
    void disconnect();
    void notify_temperature(float temp);

    BleState state() const { return state_; }

    void set_on_connect(ConnectCallback cb)    { on_connect_ = cb; }
    void set_on_disconnect(DisconnectCallback cb) { on_disconnect_ = cb; }

private:
    BleManager() = default;

    void handle_connected(struct bt_conn *conn, uint8_t err);
    void handle_disconnected(struct bt_conn *conn, uint8_t reason);

    /* Static trampolines for Zephyr C callbacks */
    static void connected_cb(struct bt_conn *conn, uint8_t err);
    static void disconnected_cb(struct bt_conn *conn, uint8_t reason);

    BleState state_{BleState::Idle};
    struct bt_conn *conn_{nullptr};
    ConnectCallback on_connect_;
    DisconnectCallback on_disconnect_;
};

} // namespace sensor_node
```

## src/led.cpp
```c
#include "led.hpp"
#include <zephyr/kernel.h>

namespace sensor_node {

Led::Led(const gpio_dt_spec &spec) : spec_(spec)
{
    /* TODO: configure GPIO as output */
}

void Led::on() const
{
    /* TODO */
}

void Led::off() const
{
    /* TODO */
}

void Led::toggle() const
{
    /* TODO */
}

bool Led::is_on() const
{
    /* TODO */
    return false;
}

void Led::blink(int times, uint32_t on_ms, uint32_t off_ms) const
{
    for (int i = 0; i < times; ++i) {
        on();
        k_msleep(on_ms);
        off();
        k_msleep(off_ms);
    }
}

} // namespace sensor_node
```

## src/led.hpp
```c
#pragma once
#include <zephyr/drivers/gpio.h>

namespace sensor_node {

class Led {
public:
    explicit Led(const gpio_dt_spec &spec);

    Led(const Led &) = delete;
    Led &operator=(const Led &) = delete;

    void on() const;
    void off() const;
    void toggle() const;
    bool is_on() const;

    void blink(int times, uint32_t on_ms, uint32_t off_ms) const;

private:
    const gpio_dt_spec &spec_;
};

} // namespace sensor_node
```

## src/ring_buffer.hpp
```c
#pragma once
#include <array>
#include <cstddef>

namespace sensor_node {

/* Paste your completed RingBuffer from Exercise 05 here.
 * This is the header-only, stack-allocated version. */
template <typename T, size_t N>
class RingBuffer {
public:
    static_assert(N > 0, "RingBuffer size must be greater than zero");

    bool push(const T &item);
    bool pop(T &out);
    bool is_empty() const;
    bool is_full() const;
    size_t size() const { return count_; }
    static constexpr size_t capacity() { return N; }

private:
    std::array<T, N> buf_{};
    size_t head_{0};
    size_t tail_{0};
    size_t count_{0};
};

/* --- Inline implementations (header-only template) --- */

template <typename T, size_t N>
bool RingBuffer<T, N>::push(const T &item)
{
    /* TODO: copy from Exercise 05 */
    return false;
}

template <typename T, size_t N>
bool RingBuffer<T, N>::pop(T &out)
{
    /* TODO: copy from Exercise 05 */
    return false;
}

template <typename T, size_t N>
bool RingBuffer<T, N>::is_empty() const
{
    /* TODO */
    return true;
}

template <typename T, size_t N>
bool RingBuffer<T, N>::is_full() const
{
    /* TODO */
    return false;
}

} // namespace sensor_node
```

## src/sensor.cpp
```c
#include "sensor.hpp"

namespace sensor_node {

const char *sensor_error_name(SensorError e)
{
    switch (e) {
    case SensorError::NotReady:   return "NotReady";
    case SensorError::CrcFail:    return "CrcFail";
    case SensorError::Timeout:    return "Timeout";
    case SensorError::OutOfRange: return "OutOfRange";
    default:                      return "Unknown";
    }
}

SimTempSensor::SimTempSensor() : temp_(20.0f), call_count_(0) {}

Result<float, SensorError> SimTempSensor::read()
{
    ++call_count_;

    /* Simulate occasional failures */
    if (call_count_ % 13 == 0) return Result<float, SensorError>::err(SensorError::CrcFail);
    if (call_count_ % 7  == 0) return Result<float, SensorError>::err(SensorError::Timeout);

    temp_ += 0.25f;
    if (temp_ > 30.0f) temp_ = 20.0f;

    return Result<float, SensorError>::ok(temp_);
}

} // namespace sensor_node
```

## src/sensor.hpp
```c
#pragma once
#include <optional>

namespace sensor_node {

enum class SensorError { NotReady, CrcFail, Timeout, OutOfRange };

const char *sensor_error_name(SensorError e);

template <typename T, typename E>
class Result {
public:
    static Result ok(T value);
    static Result err(E error);
    bool is_ok()  const;
    bool is_err() const;
    T value() const;
    E error() const;
private:
    Result() = default;
    /* TODO: implement storage (from Exercise 08) */
};

/* Abstract base */
class Sensor {
public:
    virtual ~Sensor() = default;
    virtual Result<float, SensorError> read() = 0;
    virtual const char *name() const = 0;
};

/* Simulated temperature sensor */
class SimTempSensor : public Sensor {
public:
    SimTempSensor();
    Result<float, SensorError> read() override;
    const char *name() const override { return "SimTemp"; }
private:
    float temp_{20.0f};
    int call_count_{0};
};

} // namespace sensor_node
```

## src/sensor_thread.cpp
```c
#include "sensor_thread.hpp"
#include <zephyr/sys/printk.h>

namespace sensor_node {

SensorThread::SensorThread(Sensor &sensor, Led &error_led, Led &heartbeat_led)
    : sensor_(sensor), error_led_(error_led), heartbeat_led_(heartbeat_led)
{
}

void SensorThread::start()
{
    k_thread_create(&thread_, stack_, K_THREAD_STACK_SIZEOF(stack_),
                    entry, this, nullptr, nullptr,
                    7, 0, K_NO_WAIT);
    k_thread_name_set(&thread_, "sensor");
}

float SensorThread::latest_sample() const
{
    return latest_;
}

void SensorThread::entry(void *arg, void *, void *)
{
    static_cast<SensorThread *>(arg)->run();
}

void SensorThread::run()
{
    while (true) {
        heartbeat_led_.toggle();

        auto result = sensor_.read();
        if (result.is_ok()) {
            latest_ = result.value();
            history_.push(latest_);

            printk("[Sensor] %.1f C\n", static_cast<double>(latest_));

            if (on_sample_) {
                on_sample_(latest_);
            }
        } else {
            printk("[Sensor] Error: %s\n", sensor_error_name(result.error()));
            error_led_.blink(3, 100, 100);
        }

        k_msleep(200);
    }
}

} // namespace sensor_node
```

## src/sensor_thread.hpp
```c
#pragma once
#include "sensor.hpp"
#include "ring_buffer.hpp"
#include "led.hpp"
#include <zephyr/kernel.h>
#include <functional>

namespace sensor_node {

class SensorThread {
public:
    using SampleCallback = std::function<void(float)>;

    SensorThread(Sensor &sensor, Led &error_led, Led &heartbeat_led);

    void set_sample_callback(SampleCallback cb) { on_sample_ = cb; }
    void start();

    float latest_sample() const;

private:
    static void entry(void *arg, void *, void *);
    void run();

    Sensor &sensor_;
    Led &error_led_;
    Led &heartbeat_led_;
    SampleCallback on_sample_;
    float latest_{0.0f};

    RingBuffer<float, 16> history_;

    K_THREAD_STACK_MEMBER(stack_, 2048);
    k_thread thread_{};
};

} // namespace sensor_node
```
